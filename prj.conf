## CMakeLists.txt
```
cmake_minimum_required(VERSION 3.20.0)

find_package(Zephyr REQUIRED HINTS $ENV{ZEPHYR_BASE})
project(safeguard_node)

target_sources(app PRIVATE
  src/main.c
  src/bus/zbus_channels.c
  src/logic/proc.c
  src/actuators/led.c
  src/actuators/buzzer.c
  src/sensor/adxl345.c
  src/shell/shell_cmd.c
  src/settings/settings_nvs.c
)

target_include_directories(app PRIVATE src)
```

## prj.conf
```kconfig
CONFIG_LOG=y
CONFIG_LOG_DEFAULT_LEVEL=3
CONFIG_ZBUS=y

# Shell UART
CONFIG_SHELL=y
CONFIG_SHELL_BACKEND_SERIAL=y

# Settings + NVS (persistência em flash)
CONFIG_SETTINGS=y
CONFIG_SETTINGS_NVS=y
CONFIG_NVS=y
CONFIG_FLASH=y
CONFIG_FLASH_MAP=y
CONFIG_MPU_ALLOW_FLASH_WRITE=y

# Para QEMU: desabilita persistência real, mantém comportamento runtime
# CONFIG_SETTINGS_NVS=n
# CONFIG_NVS=n
# CONFIG_FLASH=n
# CONFIG_FLASH_MAP=n
# CONFIG_MPU_ALLOW_FLASH_WRITE=n
# CONFIG_SETTINGS_RUNTIME=y
```

## src/main.c
```c
#include <zephyr/kernel.h>
#include <zephyr/logging/log.h>
#include "settings/settings_nvs.h"

LOG_MODULE_REGISTER(safeguard, LOG_LEVEL_INF);

int main(void)
{
	sg_settings_init();
	LOG_INF("SafeGuard Node iniciando...");

	while (1) {
		k_sleep(K_SECONDS(100));
	}

	return 0;
}
```

## src/zbus_channels.c
```c
#include "zbus_channels.h"

ZBUS_SUBSCRIBER_DEFINE(proc_sub,   8);
ZBUS_SUBSCRIBER_DEFINE(led_sub,    4);
ZBUS_SUBSCRIBER_DEFINE(buzzer_sub, 4);

ZBUS_CHAN_DEFINE(accel_data, struct sg_accel, NULL, NULL, ZBUS_OBSERVERS(proc_sub), ZBUS_MSG_INIT(0));
ZBUS_CHAN_DEFINE(system_state, enum sg_state, NULL, NULL, ZBUS_OBSERVERS(led_sub, buzzer_sub), ZBUS_MSG_INIT(0));
ZBUS_CHAN_DEFINE(arm_event, struct sg_arm_cmd, NULL, NULL, ZBUS_OBSERVERS(proc_sub), ZBUS_MSG_INIT(0));
```
